#include <Wire.h>
#include <Adafruit_SH1106.h>
#define IR_SEND_DUTY_CYCLE_PERCENT 50
#include <IRremote.hpp>

#define GUN_TRIGGER_PIN 2              // D2, input pin for detecting Gun trigger
#define IR_TRANSMIT_PIN 3              // D3 PWM, pin for IR transmission
#define RESET_SWITCH 4                 // D4, reset switch

#define OLED_RESET 4                   // SH1106 doesn't have RESET pin, but setting OLED_RESET to -1 causes errors
Adafruit_SH1106 display(OLED_RESET);   // Constructor for SH1106 OLED 'object'
#define MAX_NUM_AMMO 6

#define FLASH_PLAYER_ONE_RED_BASE
//#define FLASH_PLAYER_TWO_BLACK_BASE

struct Ackpacket {
  uint8_t type; //b
  uint16_t padding_1; //h
  uint16_t padding_2; //h
  uint16_t padding_3; //h
  uint16_t padding_4; //h
  uint16_t padding_5; //h
  uint16_t padding_6; //h
  uint16_t padding_7; //h
  uint8_t padding_8; //b
  uint32_t crcsum; //i
};

struct Datapacket {
  uint8_t type;
  uint16_t bullet_count;
  uint16_t shot_fired;
  uint16_t padding_1;
  uint16_t padding_2;
  uint16_t padding_3;
  uint16_t padding_4;
  uint16_t sequence_number;
  uint8_t padding_5;
  uint32_t crcsum;
};

uint8_t seq_no;
uint8_t prev_seq_no;
uint16_t shot_fired;
char currentState;
bool sentHandshakeAck;
char msg;
unsigned long lastPacketSentTime = 0;

Datapacket sentPackets[1]; // Only store prev sent packet due to memory

const unsigned char image_bullets[MAX_NUM_AMMO+1][1024] PROGMEM = {
  { // 'bullets_0, 128x64px
    0xff, 0xff, 0xff, 0xff, 0xff, 0xff, 0xff, 0xff, 0xff, 0xff, 0xff, 0xff, 0xff, 0xff, 0xff, 0xff, 
    0xff, 0xff, 0xff, 0xfe, 0x1f, 0xff, 0xe0, 0xff, 0xff, 0x07, 0xff, 0xf8, 0x3f, 0xff, 0xe1, 0xff, 
    0xff, 0x83, 0xff, 0xfc, 0x1f, 0xff, 0xe0, 0xff, 0xff, 0x07, 0xff, 0xf0, 0x3f, 0xff, 0xc1, 0xff, 
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    0xff, 0xff, 0xff, 0xff, 0xff, 0xff, 0xff, 0xff, 0xff, 0xff, 0xff, 0xff, 0xff, 0xff, 0xff, 0xff
  }, 

  { // 'bullets_1, 128x64px
    0xff, 0xff, 0xff, 0xff, 0xff, 0xff, 0xff, 0xff, 0xff, 0xff, 0xff, 0xff, 0xff, 0xff, 0xff, 0xff, 
    0xff, 0xff, 0xff, 0xff, 0xff, 0xff, 0xf0, 0xff, 0xff, 0x87, 0xff, 0xf8, 0x3f, 0xff, 0xff, 0xff, 
    0xff, 0xff, 0xff, 0xfc, 0x1f, 0xff, 0xe0, 0x7f, 0xff, 0x03, 0xff, 0xf8, 0x3f, 0xff, 0xe0, 0xff, 
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    0xff, 0xff, 0xff, 0xff, 0xff, 0xff, 0xff, 0xff, 0xff, 0xff, 0xff, 0xff, 0xff, 0xff, 0xff, 0xff  
  },

  { // 'bullets_2, 128x64px
    0xff, 0xff, 0xff, 0xff, 0xff, 0xff, 0xff, 0xff, 0xff, 0xff, 0xff, 0xfc, 0x3f, 0xff, 0xff, 0xff, 
    0xff, 0xff, 0xff, 0xff, 0xff, 0xff, 0xf0, 0x7f, 0xff, 0x83, 0xff, 0xf8, 0x1f, 0xff, 0xe0, 0xff, 
    0xff, 0x83, 0xff, 0xfe, 0x0f, 0xff, 0xf0, 0x7f, 0xff, 0x83, 0xff, 0xf8, 0x1f, 0xff, 0xe0, 0xff, 
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    0xff, 0xff, 0xff, 0xff, 0xff, 0xff, 0xff, 0xff, 0xff, 0xff, 0xff, 0xff, 0xff, 0xff, 0xff, 0xff
  },

  { // 'bullets_3, 128x64px
    0xff, 0xff, 0xff, 0xff, 0xff, 0xff, 0xff, 0xff, 0xff, 0xff, 0xff, 0xff, 0xff, 0xff, 0xff, 0xff, 
    0xff, 0xff, 0xff, 0xff, 0xff, 0xff, 0xff, 0xff, 0xff, 0xff, 0xff, 0xff, 0xff, 0xff, 0xff, 0xff, 
    0xff, 0xff, 0xff, 0xff, 0xff, 0xff, 0xff, 0xff, 0xff, 0x83, 0xff, 0xf8, 0x3f, 0xff, 0xff, 0xff, 
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    0xff, 0xff, 0xff, 0xff, 0xff, 0xff, 0xff, 0xff, 0xff, 0xff, 0xff, 0xff, 0xff, 0xff, 0xff, 0xff
  },

  { // 'bullets_4, 128x64px
    0xff, 0xff, 0xff, 0xff, 0xff, 0xff, 0xff, 0xff, 0xff, 0xff, 0xff, 0xff, 0xff, 0xff, 0xff, 0xff, 
    0xff, 0xff, 0xff, 0xff, 0xff, 0xff, 0xff, 0xff, 0xff, 0xff, 0xff, 0xf8, 0x3f, 0xff, 0xff, 0xff, 
    0xff, 0xff, 0xff, 0xff, 0xff, 0xff, 0xff, 0xff, 0xff, 0xff, 0xff, 0xf8, 0x3f, 0xff, 0xe0, 0xff, 
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    0xff, 0xff, 0xff, 0xff, 0xff, 0xff, 0xff, 0xff, 0xff, 0xff, 0xff, 0xff, 0xff, 0xff, 0xff, 0xff
  },

  { // 'bullets_5, 128x64px
    0xff, 0xff, 0xff, 0xff, 0xff, 0xff, 0xff, 0xff, 0xff, 0xff, 0xff, 0xff, 0xff, 0xff, 0xff, 0xff, 
    0xff, 0xff, 0xff, 0xff, 0xff, 0xff, 0xff, 0xff, 0xff, 0xff, 0xff, 0xff, 0xff, 0xff, 0xff, 0xff, 
    0xff, 0xff, 0xff, 0xff, 0xff, 0xff, 0xff, 0xff, 0xff, 0xff, 0xff, 0xff, 0xff, 0xff, 0xf0, 0x7f, 
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    0xff, 0xff, 0xff, 0xff, 0xff, 0xff, 0xff, 0xff, 0xff, 0xff, 0xff, 0xff, 0xff, 0xff, 0xff, 0xff
  }, 

  { // 'bullets_6, 128x64px
    0xff, 0xff, 0xff, 0xff, 0xff, 0xff, 0xff, 0xff, 0xff, 0xff, 0xff, 0xff, 0xff, 0xff, 0xff, 0xff, 
    0xff, 0xff, 0xff, 0xff, 0xff, 0xff, 0xff, 0xff, 0xff, 0xff, 0xff, 0xff, 0xff, 0xff, 0xff, 0xff, 
    0xff, 0x07, 0xff, 0xfc, 0x1f, 0xff, 0xf0, 0x7f, 0xff, 0xc1, 0xff, 0xff, 0x07, 0xff, 0xf0, 0x7f, 
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    0xff, 0xff, 0xff, 0xff, 0xff, 0xff, 0xff, 0xff, 0xff, 0xff, 0xff, 0xff, 0xff, 0xff, 0xff, 0xff
  }
};
int ammo_remaining;

int current_gun_trigger_pin_state;
int last_gun_trigger_pin_state;
unsigned long last_debounce_time_gun_trigger;
unsigned long debounce_delay_gun_trigger;

int current_reset_switch_state;
int last_reset_switch_state;
unsigned long last_debounce_time_reset_switch;
unsigned long debounce_delay_reset_switch;


void OLED_init();
void gun_init();
void IR_transmit_init();
void reset_switch_init();

void handle_gun_firing();
void IR_transmit();
void handle_reset_switch();

void setup()
{
  Serial.begin(115200);
  OLED_init();
  gun_init();
  reset_switch_init();
  resetFlags();
}

void loop()
{
  if (Serial.available()) {
    if (Serial.peek() == 'g') 
      currentState = Serial.read();
    if (Serial.peek() == 'h') 
      currentState = Serial.read();
  }

  if (currentState != 'x') {
    switch(currentState) {
      case 's':
        handle_gun_firing();
        handle_reset_switch();
//        sendBeetleData(5); // BEETLE NUMBER
//        lastPacketSentTime = millis();
//        shot_fired = 0; // reset shot_fired everytime packet sends, regardless.
        display.clearDisplay();
        display.drawBitmap(0, 0, image_bullets[ammo_remaining], 128, 64, 1);
        display.display();
        break;
      case 'g':
        if (Serial.available() >= sizeof(uint8_t)) {
          uint8_t receivedByte = Serial.read();
          ammo_remaining = receivedByte;
          setStateToSend();
        }
        break;
      case 'h':
        resetFlags();
        sendHandshakeAck();
        waitForHandshakeAck();
        break;
      case 'i':
        IR_transmit_init();
        delay(1000);
        setStateToSend();
        break;
      default:
        resetFlags();
        break;
    }
    
  }
}

//================ Handshake =================

void sendHandshakeAck() {
  if (sentHandshakeAck) return;
  Ackpacket packet;
  packet.type = 1; // ACK
  packet.padding_1 = 0;
  packet.padding_2 = 0;
  packet.padding_3 = 0;
  packet.padding_4 = 0;
  packet.padding_5 = 0;
  packet.padding_6 = 0;
  packet.padding_7 = 0;
  packet.padding_8 = 0;
  packet.crcsum = calculateAckCrc32(&packet);
  Serial.write((uint8_t *)&packet, sizeof(packet));
  sentHandshakeAck = true;
}

void waitForHandshakeAck(){
  char ack_msg;

  while (!Serial.available());
  ack_msg = Serial.read();

  if (ack_msg != 'v') {
    resetFlags();
    return;
  }

  setStateToIrReceive();

}

void resetFlags() {
  sentHandshakeAck = false;
  seq_no = 0;
}

//=======================================================
//================ State Machine =================
void setStateToHandshake() {
  currentState = 'h';
  sentHandshakeAck = false;
}

void setStateToIrReceive(){
  currentState = 'i';
}

void setStateToSend() {
  currentState = 's';
}

void setStateToGamestate(){
  currentState = 'g';
}

//=======================================================
//================ Data handling and transmission =================
void sendBeetleData(uint8_t type) {
  Datapacket packet;
  packet.type = type;
  packet.sequence_number = seq_no;
  prev_seq_no = seq_no;
  if(seq_no < 10){
    seq_no++; // Increment the sequence number for the next packet
  } else {
    seq_no = 0;
  }
  packet.bullet_count = ammo_remaining; // Update bullet count
  packet.shot_fired = shot_fired;
  packet.crcsum = calculateDataCrc32(&packet);
  sentPackets[0] = packet;
  Serial.write((uint8_t *)&packet, sizeof(packet));
  delay(40);
}
//===========================================================

void handle_gun_firing() {
  int reading = digitalRead(GUN_TRIGGER_PIN);

  if (reading != last_gun_trigger_pin_state) {
    // Change detected, reset debounce timer
    last_debounce_time_gun_trigger = millis();
  }

  if ((millis() - last_debounce_time_gun_trigger) > debounce_delay_gun_trigger) {
      // Whatever reading is, it's been there longer than debounce delay. Take the reading as is
      if (reading != current_gun_trigger_pin_state) {
        // assert that reading is NOT due to debouncing
        current_gun_trigger_pin_state = reading;
//        ammo_remaining = (ammo_remaining == 0 && current_gun_trigger_pin_state == HIGH) ? 0 :
//                         (current_gun_trigger_pin_state == LOW) ? ammo_remaining : ammo_remaining - 1;

        if (current_gun_trigger_pin_state == HIGH) {
          IR_transmit();
          shot_fired = 1;
          sendBeetleData(5); // BEETLE NUMBER
          lastPacketSentTime = millis();
          shot_fired = 0;
        }
    }

    // Display bullet count
//    display.clearDisplay();
//    display.drawBitmap(0, 0, image_bullets[ammo_remaining], 128, 64, 1);
//    display.display();
  }
  last_gun_trigger_pin_state = reading;
}

void handle_reset_switch() {
  int reading = digitalRead(RESET_SWITCH);

  if (reading != last_reset_switch_state) {
    // Change detected, reset debounce timer
    last_debounce_time_reset_switch = millis();
  }

  if ((millis() - last_debounce_time_reset_switch) > debounce_delay_reset_switch) {
      // Whatever reading is, it's been there longer than debounce delay. Take the reading as is
      if (reading != current_reset_switch_state) {
        // assert that reading is NOT due to debouncing
        current_reset_switch_state = reading;
        ammo_remaining = MAX_NUM_AMMO;
      }
  }

  // Display bullet count
  display.clearDisplay();
  display.drawBitmap(0, 0, image_bullets[ammo_remaining], 128, 64, 1);
  display.display();

  last_reset_switch_state = reading;
}


void IR_transmit() {
  // Peak forward current = 1A
  // Continuous Forward Current = 100mA
  #ifdef FLASH_PLAYER_ONE_RED_BASE
    IrSender.sendNEC(0x100, 0x35, 0); // the address 0x0100 with the command 0x200 is sent ONCE for Player 1
  #endif

  #ifdef FLASH_PLAYER_TWO_BLACK_BASE
    IrSender.sendNEC(0x101, 0x36, 0); // the address 0x0100 with the command 0x200 is sent ONCE for Player 2
  #endif
}

void OLED_init() {
  // Begin I2C comms; Beetle(Master) -> OLED(Slave)
  //Serial.begin(9600);

  // Show Adafruit logo on OLED (sanity check)
  display.begin(SH1106_SWITCHCAPVCC, 0x3C); // Generate HIGH voltage from 3.3V internally, and initialize with I2C address of 0x3C for 128x64 display we are using
  display.display();                        // Image buffer is Adafruit splashscreen
  delay(1000);
  display.clearDisplay();                   // Clear buffer
}

void gun_init() {
  // GUN_TRIGGER_PIN is active high, (i.e. GUN_TRIGGER_PIN reads HIGH when gun trigger is squeezed)
  // GUN_TRIGGER_PIN is connected to GND initially, INPUT_PULLUP is to prevent floating reads
  // When gun trigger is pressed, GUN_TRIGGER_PIN connects to Vdd
  pinMode(GUN_TRIGGER_PIN, INPUT_PULLUP);

  // Global counter to keep track of how much ammo left, wraps around from 0->6
  ammo_remaining = MAX_NUM_AMMO;

  // Debouncing the gun trigger
  current_gun_trigger_pin_state = HIGH; // Pin is in active high configuration
  last_gun_trigger_pin_state = HIGH;    // Pin is in active high configuration
  last_debounce_time_gun_trigger = 0;
  debounce_delay_gun_trigger = 100;
}

void IR_transmit_init() {
  IrSender.begin(IR_TRANSMIT_PIN);
}

void reset_switch_init() {
  pinMode(RESET_SWITCH, INPUT_PULLUP);

  // Debouncing the reset trigger
  current_reset_switch_state = HIGH; // Pin is in active high configuration
  last_reset_switch_state = HIGH;    // Pin is in active high configuration
  last_debounce_time_reset_switch = 0;
  debounce_delay_reset_switch = 100;
}

//========================Calculate CRC======================

uint32_t calculateDataCrc32(Datapacket *pkt) {
  return custom_crc32(&pkt->type, 
    sizeof(pkt->type) +
    sizeof(pkt->bullet_count) +
    sizeof(pkt->shot_fired) +
    sizeof(pkt->padding_1) +
    sizeof(pkt->padding_2) +
    sizeof(pkt->padding_3) +
    sizeof(pkt->padding_4) +
    sizeof(pkt->sequence_number) +
    sizeof(pkt->padding_5)
  );
}

uint32_t calculateAckCrc32(Ackpacket *pkt) {
  return custom_crc32(&pkt->type, 
    sizeof(pkt->type) +
    sizeof(pkt->padding_1) +
    sizeof(pkt->padding_2) +
    sizeof(pkt->padding_3) +
    sizeof(pkt->padding_4) +
    sizeof(pkt->padding_5) +
    sizeof(pkt->padding_6) +
    sizeof(pkt->padding_7) +
    sizeof(pkt->padding_8)
  );
}

//===========================================================

//====================Custom CRC Library======================


uint32_t custom_crc32(const uint8_t *data, size_t len) {
  uint32_t crc = 0x00000000;
  
  for (size_t i = 0; i < len; i++) {
    crc ^= data[i];
    for (int j = 0; j < 8; j++) {
      crc = (crc & 1) ? ((crc >> 1) ^ 0x04C11DB7) : (crc >> 1);
    }
  }
  
  return crc;
}
